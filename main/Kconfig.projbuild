## main/Kconfig.projbuild
```kconfig
menu "Example configuration"

    choice EXAMPLE_MEASURING_MODE
        prompt "Select measuring mode"
        default EXAMPLE_MEASURING_MODE_TRIGGER
        config EXAMPLE_MEASURING_MODE_TRIGGER
            bool "Trigger measurements"
            help
                Measuring mode to use. See 8.3.1 Basic ADC Functions in the datasheet.
        config EXAMPLE_MEASURING_MODE_CONTINUOUS
            bool "Continuous  measurements"
            help
                Measuring mode to use. See 8.3.1 Basic ADC Functions in the datasheet.

        config EXAMPLE_DUMP_ADV_DATA_AND_SCAN_RESP
            bool "Dump whole adv data and scan response data in example"
            default n
    
        config EXAMPLE_CI_ID
            int
            default 70
            help
                This config the example id for CI test. Only for internal used.
    
        config EXAMPLE_CI_PIPELINE_ID
            int "The pipeline id for CI test"
            default 0
            help
                This config the pipeline id for CI test. Only for internal used.
    endchoice

    config EXAMPLE_I2C_MASTER_SCL
        int "SCL GPIO Number"
        default 5 if IDF_TARGET_ESP8266
        default 6 if IDF_TARGET_ESP32C3
        default 19 if IDF_TARGET_ESP32 || IDF_TARGET_ESP32S2 || IDF_TARGET_ESP32S3
        default 4 if IDF_TARGET_ESP32H2
        help
            GPIO number for I2C Master clock line.

    config EXAMPLE_I2C_MASTER_SDA
        int "SDA GPIO Number"
        default 4 if IDF_TARGET_ESP8266
        default 5 if IDF_TARGET_ESP32C3
        default 18 if IDF_TARGET_ESP32 || IDF_TARGET_ESP32S2 || IDF_TARGET_ESP32S3
        default 3 if IDF_TARGET_ESP32H2
        help
            GPIO number for I2C Master data line.
endmenu
```
